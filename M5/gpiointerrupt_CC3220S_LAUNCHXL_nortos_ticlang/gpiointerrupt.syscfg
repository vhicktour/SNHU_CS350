/**
 * @cliArgs --board "/ti/boards/CC3220S_LAUNCHXL" --rtos "nortos" --product "simplelink_cc32xx_sdk@7.10.00.13"
 * @versions {"tool":"1.20.0+3587"}
 */

/**
 * Import the modules used in this configuration.
 */
const GPIO   = scripting.addModule("/ti/drivers/GPIO");
const GPIO1  = GPIO.addInstance();
const GPIO2  = GPIO.addInstance();
const GPIO3  = GPIO.addInstance();
const GPIO4  = GPIO.addInstance();
const Power  = scripting.addModule("/ti/drivers/Power");
const Timer  = scripting.addModule("/ti/drivers/Timer", {}, false);
const Timer1 = Timer.addInstance();

/**
 * Write custom configuration values to the imported modules.
 */
GPIO1.$hardware = system.deviceData.board.components.SW2;
GPIO1.$name     = "CONFIG_GPIO_BUTTON_0";

GPIO2.$hardware = system.deviceData.board.components.SW3;
GPIO2.$name     = "CONFIG_GPIO_BUTTON_1";

GPIO3.$hardware = system.deviceData.board.components.LED_RED;
GPIO3.$name     = "CONFIG_GPIO_LED_0";

GPIO4.$hardware = system.deviceData.board.components.LED_GREEN;
GPIO4.$name     = "CONFIG_GPIO_LED_1";

Power.parkPins.$name = "ti_drivers_power_PowerCC32XXPins0";

Timer1.$name     = "CONFIG_TIMER_0";
Timer1.timerType = "32 Bits";

/**
 * Pinmux solution for unlocked pins/peripherals. This ensures that minor changes to the automatic solver in a future
 * version of the tool will not impact the pinmux you originally saw.  These lines can be completely deleted in order to
 * re-solve from scratch.
 */
GPIO1.gpioPin.$suggestSolution = "boosterpack.3";
GPIO2.gpioPin.$suggestSolution = "boosterpack.11";
GPIO3.gpioPin.$suggestSolution = "boosterpack.29";
GPIO4.gpioPin.$suggestSolution = "boosterpack.10";
Timer1.timer.$suggestSolution  = "Timer0";
